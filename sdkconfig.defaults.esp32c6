## sdkconfig.defaults.esp32c6
```kconfig
# MimiClaw - ESP32-C6 Target Configuration
CONFIG_IDF_TARGET="esp32c6"

# Flash 4MB + QIO
CONFIG_ESPTOOLPY_FLASHSIZE_4MB=y
CONFIG_ESPTOOLPY_FLASHMODE_QIO=y

# CPU 160MHz (C6 max)
CONFIG_ESP_DEFAULT_CPU_FREQ_MHZ_160=y

# NO PSRAM on this board
CONFIG_SPIRAM_SUPPORT=n

# Allow RTC fast memory as heap for extra SRAM
CONFIG_ESP_SYSTEM_ALLOW_RTC_FAST_MEM_AS_HEAP=y

# WiFi memory optimization (critical for no-PSRAM)
CONFIG_ESP_WIFI_STATIC_RX_BUFFER_NUM=2
CONFIG_ESP_WIFI_DYNAMIC_RX_BUFFER_NUM=4
CONFIG_ESP_WIFI_RX_BA_WIN=2
CONFIG_LWIP_TCPIP_RECVMBOX_SIZE=8

# Reduce socket count
CONFIG_LWIP_MAX_SOCKETS=8

# TLS optimization (dynamic buffers to save RAM)
CONFIG_MBEDTLS_DYNAMIC_BUFFER=y
CONFIG_MBEDTLS_DYNAMIC_FREE_PEER_CERT=y
CONFIG_MBEDTLS_DYNAMIC_FREE_CA_CERT=y
CONFIG_MBEDTLS_DYNAMIC_FREE_CONFIG_DATA=y
CONFIG_MBEDTLS_SSL_IN_CONTENT_LEN=16384
CONFIG_MBEDTLS_SSL_OUT_CONTENT_LEN=4096

# WebSocket support
CONFIG_HTTPD_WS_SUPPORT=y

# Custom partition table (4MB flash layout)
CONFIG_PARTITION_TABLE_CUSTOM=y
CONFIG_PARTITION_TABLE_CUSTOM_FILENAME="partitions_c6.csv"

# Disable OTA (no space for dual partitions)
CONFIG_BOOTLOADER_APP_ROLLBACK_ENABLE=n

# FreeRTOS optimizations
CONFIG_FREERTOS_HZ=100

# Task watchdog timeout
CONFIG_ESP_TASK_WDT_TIMEOUT_S=10

# Console: UART primary (non-blocking), USB Serial/JTAG secondary
CONFIG_ESP_CONSOLE_UART_DEFAULT=y
CONFIG_ESP_CONSOLE_SECONDARY_USB_SERIAL_JTAG=y

# Memory optimizations
CONFIG_ESP_SYSTEM_EVENT_TASK_STACK_SIZE=2048
CONFIG_ESP_TIMER_TASK_STACK_SIZE=3072

# Reduce log output to save RAM
CONFIG_LOG_DEFAULT_LEVEL_INFO=y

# SNTP: no random startup delay, allow up to 3 servers
CONFIG_LWIP_SNTP_STARTUP_DELAY=n
CONFIG_LWIP_SNTP_MAX_SERVERS=3

# Cross-signed cert verification (needed for GoDaddy/Telegram cert chain)
CONFIG_MBEDTLS_CERTIFICATE_BUNDLE_CROSS_SIGNED_VERIFY=y
```
